## config/boards/shields/pyramidka/Kconfig.defconfig
```kconfig
# Copyright (c) 2022 The ZMK Contributors
# SPDX-License-Identifier: MIT
if PYRAMIDKA

config ZMK_KEYBOARD_NAME
	default "pyramidka"
	
endif



config ZMK_SPLIT
	default n
```

## config/boards/shields/pyramidka/Kconfig.shield
```kconfig
# Copyright (c) 2022 The ZMK Contributors
# SPDX-License-Identifier: MIT

config PYRAMIDKA
    def_bool $(shields_list_contains,pyrmidka)
```

## config/west.yml
```yaml
manifest:
  remotes:
    - name: zmkfirmware
      url-base: https://github.com/alinelena
  projects:
    - name: zmk
      remote: zmkfirmware
      revision: mlego_rp2040
      import: app/west.yml
  self:
    path: config
```
